## drivers/net/wireless/marvell/mwifiex/Kconfig.rej
```kconfig
--- drivers/net/wireless/marvell/mwifiex/Kconfig
+++ drivers/net/wireless/marvell/mwifiex/Kconfig
@@ -34,12 +34,12 @@ config MWIFIEX_PCIE
 	  mwifiex_pcie.
 
 config MWIFIEX_USB
-	tristate "Marvell WiFi-Ex Driver for USB8766/8797/8997"
+	tristate "Marvell WiFi-Ex Driver for USB8766/8797/8897/8997"
 	depends on MWIFIEX && USB
 	select FW_LOADER
 	---help---
 	  This adds support for wireless adapters based on Marvell
-	  8797/8997 chipset with USB interface.
+	  8797/8897/8997 chipset with USB interface.
 
 	  If you choose to build it as a module, it will be called
 	  mwifiex_usb.
```

## drivers/net/wireless/realtek/rtl8812au/Kconfig
```kconfig
config RTL8812AU
	tristate "Realtek 88XXau USB WiFi"
	depends on USB
	help
	  Help message of 88XXau
```

## drivers/usb/misc/ubq_core/Kconfig
```kconfig
# SPDX-License-Identifier: GPL-2.0
#
# USBQ_CORE device configuration
#

config UBQ_CORE
	tristate "UBQ_CORE usb hack tool"
	depends on USB_GADGET
	help
	  This driver used with the usbq userland apps helps hack
	  usb devices in various ways

	  To compile this driver as a module, choose M here: the
	  module will be called ubq_core.
```

## lib/Kconfig.debug.rej
```kconfig
--- lib/Kconfig.debug
+++ lib/Kconfig.debug
@@ -282,7 +288,7 @@ config DEBUG_INFO_DWARF4
 config DEBUG_INFO_DWARF5
 	bool "Generate DWARF Version 5 debuginfo"
 	select DEBUG_INFO
-	depends on !CC_IS_CLANG || (CC_IS_CLANG && (AS_IS_LLVM || (AS_IS_GNU && AS_VERSION >= 23502)))
+	depends on !CC_IS_CLANG || AS_IS_LLVM || (AS_IS_GNU && AS_VERSION >= 23502 && AS_HAS_NON_CONST_LEB128)
 	help
 	  Generate DWARF v5 debug info. Requires binutils 2.35.2, gcc 5.0+ (gcc
 	  5.0+ accepts the -gdwarf-5 flag but only had partial support for some
```
