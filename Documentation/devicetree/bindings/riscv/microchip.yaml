## drivers/misc/Kconfig.rej
```kconfig
--- drivers/misc/Kconfig
+++ drivers/misc/Kconfig
@@ -537,4 +537,5 @@ source "drivers/misc/mic/Kconfig"
 source "drivers/misc/genwqe/Kconfig"
 source "drivers/misc/echo/Kconfig"
 source "drivers/misc/cxl/Kconfig"
+source "drivers/misc/nunchuk/Kconfig"
 endmenu
```

## drivers/misc/nunchuk/Kconfig
```kconfig
config NUNCHUK
	tristate "Nunchuk support"
	default n
	help
	  This driver provides support for the stupendous Nunchuk driver.

	  To compile this driver as a module, choose M here. The module
	  will be called nunchuk.
```
